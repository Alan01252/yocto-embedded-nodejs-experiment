## build/conf/bblayers.conf
```bitbake
# POKY_BBLAYERS_CONF_VERSION is increased each time build/conf/bblayers.conf
# changes incompatibly
POKY_BBLAYERS_CONF_VERSION = "2"

BBPATH = "${TOPDIR}"
BBFILES ?= ""

BBLAYERS ?= " \
  /home/vagrant/yocto-embedded-nodejs-experiment/meta \
  /home/vagrant/yocto-embedded-nodejs-experiment/meta-poky \
  /home/vagrant/yocto-embedded-nodejs-experiment/meta-yocto-bsp \
  /home/vagrant/yocto-embedded-nodejs-experiment/oe-meta-go \
  /home/vagrant/yocto-embedded-nodejs-experiment/meta-mender/meta-mender-core \
  /home/vagrant/yocto-embedded-nodejs-experiment/meta-mender/meta-mender-demo \
  /home/vagrant/yocto-embedded-nodejs-experiment/meta-mender/meta-mender-qemu \
  /home/vagrant/yocto-embedded-nodejs-experiment/meta-ifu \
  /home/vagrant/yocto-embedded-nodejs-experiment/meta-nodejs \
  "

EXTRALAYERS +=" \
  /workdir/poky/meta-nodejs \
"
```
